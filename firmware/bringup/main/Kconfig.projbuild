## firmware/bringup/main/Kconfig.projbuild
```kconfig
choice SENTINEL_BRINGUP_FRAMESIZE
    prompt "Default camera framesize (change per MEASUREMENTS.md row)"
    default SENTINEL_BRINGUP_FRAMESIZE_HD

    config SENTINEL_BRINGUP_FRAMESIZE_VGA
        bool "VGA 640x480"
    config SENTINEL_BRINGUP_FRAMESIZE_SVGA
        bool "SVGA 800x600"
    config SENTINEL_BRINGUP_FRAMESIZE_HD
        bool "HD 1280x720"
    config SENTINEL_BRINGUP_FRAMESIZE_UXGA
        bool "UXGA 1600x1200"
endchoice

config SENTINEL_BRINGUP_JPEG_QUALITY
    int "JPEG quality (0-63, lower is higher quality)"
    range 4 30
    default 12
    help
        OV3660 JPEG quality for bench streaming. Record the value used in MEASUREMENTS.md.
```

## firmware/sentinel/sdkconfig.defaults
```kconfig
CONFIG_IDF_TARGET="esp32s3"

CONFIG_ESPTOOLPY_FLASHSIZE_16MB=y
CONFIG_ESPTOOLPY_FLASHMODE_QIO=y
CONFIG_ESPTOOLPY_FLASHFREQ_80M=y
CONFIG_PARTITION_TABLE_CUSTOM=y
CONFIG_PARTITION_TABLE_CUSTOM_FILENAME="partitions.csv"

CONFIG_ESP32S3_DEFAULT_CPU_FREQ_240=y
CONFIG_ESP32S3_BROWNOUT_DET=y

CONFIG_SPIRAM=y
CONFIG_SPIRAM_MODE_OCT=y
CONFIG_SPIRAM_SPEED_80M=y
CONFIG_SPIRAM_USE_MALLOC=y
CONFIG_SPIRAM_MALLOC_ALWAYSINTERNAL=4096

CONFIG_FREERTOS_HZ=1000
CONFIG_ESP_TASK_WDT=y
CONFIG_ESP_TASK_WDT_TIMEOUT_S=30
CONFIG_ESP_TASK_WDT_CHECK_IDLE_TASK_CPU0=y
CONFIG_ESP_TASK_WDT_CHECK_IDLE_TASK_CPU1=y

CONFIG_HTTPD_MAX_REQ_HDR_LEN=1024
CONFIG_HTTPD_MAX_URI_LEN=512

CONFIG_ESP_WIFI_STATIC_RX_BUFFER_NUM=10
CONFIG_ESP_WIFI_DYNAMIC_RX_BUFFER_NUM=32
CONFIG_ESP_WIFI_DYNAMIC_TX_BUFFER_NUM=32
CONFIG_LWIP_MAX_SOCKETS=12

CONFIG_BT_ENABLED=y
CONFIG_BT_NIMBLE_ENABLED=y
# CONFIG_BT_BLUEDROID_ENABLED is not set

CONFIG_NETWORK_PROV_NETWORK_TYPE_WIFI=y
CONFIG_NETWORK_PROV_TRANSPORT_BLE=y
CONFIG_NETWORK_PROV_SECURITY_VERSION_2=y
CONFIG_NETWORK_PROV_SEC2_DEV_MODE=n
CONFIG_NETWORK_PROV_SEC2_PROD_MODE=y

CONFIG_ESP_PROTOCOMM_SUPPORT_SECURITY_VERSION_2=y

CONFIG_MBEDTLS_HARDWARE_AES=y
CONFIG_MBEDTLS_HARDWARE_SHA=y

CONFIG_MQTT_PROTOCOL_311=y
CONFIG_MQTT_TRANSPORT_SSL=n
```
